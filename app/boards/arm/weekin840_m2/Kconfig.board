## app/boards/arm/weekin840_m2/Kconfig.board
```kconfig
# Maker Diary nrf52840 M.2 board configuration

# Copyright (c) 2020 The ZMK Contributors
# SPDX-License-Identifier: MIT

config BOARD_WEEKIN840_M2
	bool "weekin840_m2"
	depends on SOC_NRF52840_QIAA
```

## config/boards/shields/weekin_roc/Kconfig.shield
```kconfig
# Copyright (c) 2022 The ZMK Contributors
# SPDX-License-Identifier: MIT

config SHIELD_WEEKIN_ROC
    def_bool $(shields_list_contains,weekin_roc)
```

## config/west.yml
```yaml
manifest:
  remotes:
    - name: zmkfirmware
      url-base: https://github.com/zmkfirmware
    - name: kuolemax
      url-base: https://github.com/kuolemax
  projects:
    - name: zmk
      remote: kuolemax
      revision: encoder-fix
      import: app/west.yml
  self:
    path: config
```
